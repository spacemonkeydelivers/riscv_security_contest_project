## zephyrproject/zephyr/boards/riscv32/beehive_riscv32/Kconfig.board
```kconfig
config BOARD_BEEHIVE
	bool "Bljad dat BeeHive board"
	depends on SOC_BEEHIVE_RISCV32
```

## zephyrproject/zephyr/boards/riscv32/beehive_riscv32/beehive_riscv32_defconfig
```kconfig
CONFIG_RISCV32=y
CONFIG_SOC_SERIES_BEEHIVE_RISCV32=y
CONFIG_SOC_BEEHIVE_RISCV32=y
CONFIG_BOARD_BEEHIVE=y
CONFIG_CONSOLE=y
CONFIG_SERIAL=y
CONFIG_UART_BEEHIVE=y
CONFIG_UART_BEEHIVE_PORT_0=y
CONFIG_UART_BEEHIVE_PORT_0_NAME="uart0"
CONFIG_UART_CONSOLE=y
CONFIG_UART_CONSOLE_ON_DEV_NAME="uart0"
CONFIG_PLIC=n
CONFIG_RISCV_MACHINE_TIMER=y
CONFIG_GPIO=n
CONFIG_XIP=y
```

## zephyrproject/zephyr/drivers/serial/Kconfig.beehive
```kconfig
# Kconfig.fe310 - BeeHive Freedom UART configuration option
#
# Copyright (c) 2019 Bee King <BeeKingTheAmazing@gmail.com>
#
# SPDX-License-Identifier: Apache-2.0
#

menuconfig UART_BEEHIVE
	bool "BeeHive serial driver"
	depends on SOC_BEEHIVE_RISCV32
	select SERIAL_HAS_DRIVER
	help
	  This option enables the BeeHive Freedom serial driver.

# ---------- Port 0 ----------

menuconfig UART_BEEHIVE_PORT_0
	bool "Enable BEEHIVE Port 0"
	depends on UART_BEEHIVE
	help
	  This tells the driver to configure the UART port at boot, depending on
	  the additional configure options below.

config UART_BEEHIVE_PORT_0_NAME
    string "Port 0 Device Name"
    default "uart0"
    depends on UART_BEEHIVE_PORT_0
    help
      This is the device name for UART, and is included in the device
      struct.
```

## zephyrproject/zephyr/soc/riscv32/riscv-privilege/beehive_riscv32/Kconfig.defconfig.series
```kconfig
# SPDX-License-Identifier: Apache-2.0

if SOC_SERIES_BEEHIVE_RISCV32

config SOC_SERIES
	string
	default "beehive_riscv32"

config SYS_CLOCK_HW_CYCLES_PER_SEC
	int
	default 133000000

config BEEHIVE_FAKE_TIME_WA
  bool
  default y

config BEEHIVE_TIMER_INIT_PRIORITY
        int
        default 45

config RISCV_SOC_INTERRUPT_INIT
	bool
	default y

config RISCV_HAS_CPU_IDLE
	bool
	default y

config RISCV_HAS_PLIC
	bool
	default n

config NUM_IRQS
	int
	default 16

config XIP
	bool
	default y

config RISCV_ROM_BASE_ADDR
	hex
	default 0x1000

config RISCV_ROM_SIZE
	hex
	default 0x12000

config RISCV_RAM_BASE_ADDR
	hex
	default	0x12000

config RISCV_RAM_SIZE
	hex
	default 0x7000

endif # SOC_SERIES_BEEHIVE_RISCV32
```

## zephyrproject/zephyr/soc/riscv32/riscv-privilege/beehive_riscv32/Kconfig.series
```kconfig
# Kconfig - RISCV32_SIFIVE_FREEDOM SOC implementation
#
# Copyright (c) 2017 Jean-Paul Etienne <fractalclone@gmail.com>
#
# SPDX-License-Identifier: Apache-2.0
#

config SOC_SERIES_BEEHIVE_RISCV32
	bool "The Glory Hole of The Implementation Paradise"
	depends on RISCV32
	select SOC_FAMILY_RISCV_PRIVILEGE
	help
	  Enable support for beehive for glory
```

## zephyrproject/zephyr/soc/riscv32/riscv-privilege/beehive_riscv32/Kconfig.soc
```kconfig
# Kconfig - RISCV32_SIFIVE_FREEDOM SOC configuration options
#
# Copyright (c) 2017 Jean-Paul Etienne <fractalclone@gmail.com>
#
# SPDX-License-Identifier: Apache-2.0
#

choice
prompt "The Glory Hole of The Implementation Paradise SOC implementation"
depends on SOC_SERIES_BEEHIVE_RISCV32

config SOC_BEEHIVE_RISCV32
	bool "Bljad SOC implementation"
	select ATOMIC_OPERATIONS_C

endchoice
```
